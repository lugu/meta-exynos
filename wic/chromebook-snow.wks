## wic/chromebook-snow.wks
```
# short-description: Create eMMC card image with a boot partition
# long-description: Creates a partitioned SD card image. Boot files
# are located in the first ext2 partition.

part /boot --source bootimg-partition --ondisk mmcblk --fstype=ext2 --label boot --align 1024 --size 16 --grow
part / --source rootfs --ondisk mmcblk --fstype=ext4 --label root --align 1024 --use-uuid
bootloader --ptable gpt
```
